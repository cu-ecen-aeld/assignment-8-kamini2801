## base_external/package/aesd_chardriver/Config.in
```kconfig
config BR2_PACKAGE_AESD_CHARDRIVER
	bool "aesd_chardriver"
	help
	  Custom driver based in a circular buffer
	  
```

## base_external/package/ldd/Config.in
```kconfig
config BR2_PACKAGE_LDD
	bool "ldd"
	help
	  Includes the driver in the kernel image.
	  Used to understand buildroot external trees and package builds.
```
